## artifacts/s04_linux_dt/gptalk_dma_minimal.its
```
/dts-v1/;

/ {
	description = "U-Boot fitImage for GPTalk DMA minimal Linux DT";
	#address-cells = <1>;

	images {
		kernel@0 {
			description = "Linux Kernel";
			data = /incbin/("original_kernel.bin");
			type = "kernel";
			arch = "arm";
			os = "linux";
			compression = "none";
			load = <0x00008000>;
			entry = <0x00008000>;

			hash@1 {
				algo = "sha1";
			};
		};

		fdt@0 {
			description = "GPTalk DMA minimal device tree";
			data = /incbin/("gptalk_dma_minimal.dtb");
			type = "flat_dt";
			arch = "arm";
			compression = "none";

			hash@1 {
				algo = "sha1";
			};
		};
	};

	configurations {
		default = "conf@2";

		conf@2 {
			description = "Boot Linux kernel with GPTalk DMA minimal FDT";
			kernel = "kernel@0";
			fdt = "fdt@0";

			hash@1 {
				algo = "sha1";
			};
		};
	};
};
```
